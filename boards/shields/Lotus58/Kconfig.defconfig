## boards/shields/Lotus58/Kconfig.defconfig
```kconfig
# Copyright (c) 2022 The ZMK Contributors
# SPDX-License-Identifier: MIT
if SHIELD_LOTUS58_DONGLE

config ZMK_KEYBOARD_NAME
	default "Lotus58 Dongle"
	
config ZMK_SPLIT_BLE_ROLE_CENTRAL
	default y
	
config ZMK_USB
	default y

endif

if SHIELD_LOTUS58_LEFT || SHIELD_LOTUS58_RIGHT || SHIELD_LOTUS58_DONGLE 

config ZMK_SPLIT
	default y

config ZMK_BLE
	default y
	
if ZMK_DISPLAY && (SHIELD_LOTUS58_LEFT || SHIELD_LOTUS58_RIGHT)

config I2C
    default y

config SSD1306
    default y

endif # ZMK_DISPLAY LEFT AND RIGHT

if ZMK_DISPLAY && SHIELD_LOTUS58_RIGHT

config I2C
    default y

config SH1106
    default y

endif # ZMK_DISPLAY DONGLE

if LVGL

config LV_Z_VDB_SIZE
    default 64

config LV_DPI_DEF
    default 148

config LV_Z_BITS_PER_PIXEL
    default 1

choice LV_COLOR_DEPTH
    default LV_COLOR_DEPTH_1
endchoice

endif # LVGL

endif
```

## config/west.yml
```yaml
manifest:
  remotes:
    - name: gabrielgg4
      url-base: https://github.com/gabrielgg4
    - name: englmaxi
      url-base: https://github.com/englmaxi
  projects:
    - name: zmk
      remote: gabrielgg4
      revision: main
      import: app/west.yml
    - name: zmk-dongle-display
      remote: englmaxi
      revision: main
  self:
    path: config
```
